/*
 * sht30_config.c
 *
 *  Created on: May 25, 2026
 *      Author: MSI GF63
 */


/*
 * sht30_config.c
 */

#include "sht30_config.h"

/* External declaration for the I2C handle generated by CubeIDE */
extern I2C_HandleTypeDef hi2c1;

HAL_StatusTypeDef SHT30_Init(void)
{
    /* The STM32 HAL already initializes the I2C peripheral hardware.
       Optionally send a Soft Reset command (0x30A2) to ensure a clean state. */

    if (switch_operation(TARGET_SENSOR, SWITCH_ON))
    {
        uint8_t reset_cmd[2] = {0x30, 0xA2};

        HAL_StatusTypeDef status =
            HAL_I2C_Master_Transmit(&hi2c1,
                                    SHT30_I2C_ADDR,
                                    reset_cmd,
                                    2,
                                    100);

        if (status == HAL_OK)
        {
            HAL_Delay(2);   // SHT30 requires max 1.5 ms reset time
        }
        else
        {
            printf("[ERROR] SHT30 reset command transmission failed.\r\n");
        }

        return status;
    }
    else
    {
        printf("[ERROR] Sensor power switch failed. Unable to initialize SHT30.\r\n");
        return HAL_ERROR;
    }
}

HAL_StatusTypeDef SHT30_ReadSensor(SHT30_SensorReading_t *reading)
{
    /* SHT30 Command: Single Shot, High Repeatability, Clock Stretching Disabled (0x2400) */
//    uint8_t cmd[2] = {0x24, 0x00};
	uint8_t cmd[2] = {0x24, 0x16};

    uint8_t rx_data[6];

    /* 1. Send measurement command */
    if (HAL_I2C_Master_Transmit(&hi2c1, SHT30_I2C_ADDR, cmd, 2, 100) != HAL_OK)
    {
        return HAL_ERROR;
    }

    /* 2. Wait for measurement to complete (High repeatability takes ~15ms max) */
//    HAL_Delay(15);
    HAL_Delay(4);


    /* 3. Read 6 bytes from the sensor
       [0] Temp MSB, [1] Temp LSB, [2] Temp CRC
       [3] Hum MSB,  [4] Hum LSB,  [5] Hum CRC */
    if (HAL_I2C_Master_Receive(&hi2c1, SHT30_I2C_ADDR, rx_data, 6, 100) != HAL_OK)
    {
        return HAL_ERROR;
    }

    /* 4. Combine raw bytes */
    uint16_t raw_temp = (rx_data[0] << 8) | rx_data[1];
    uint16_t raw_hum  = (rx_data[3] << 8) | rx_data[4];

    /* 5. Apply formulas and convert to float */
    float temp_c = -45.0f + (175.0f * ((float)raw_temp / 65535.0f));
    float hum_rh = 100.0f * ((float)raw_hum / 65535.0f);

    /* 6. Scale and store in struct */
    reading->temperature = (int16_t)(temp_c * 100.0f);
    reading->humidity    = (uint16_t)(hum_rh * 100.0f);


    switch_operation(TARGET_SENSOR, SWITCH_OFF);
    return HAL_OK;
}
